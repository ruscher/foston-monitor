## firmware/buildroot/package/Config.in
```kconfig
menu "BigFoston OS"
source "$BR2_EXTERNAL_BIGFOSTON_PATH/package/bigfoston-bigscreen/Config.in"
source "$BR2_EXTERNAL_BIGFOSTON_PATH/package/bigfoston-bringup/Config.in"
source "$BR2_EXTERNAL_BIGFOSTON_PATH/package/bigfoston-shell/Config.in"
endmenu
```

## firmware/buildroot/package/bigfoston-bigscreen/Config.in
```kconfig
config BR2_PACKAGE_BIGFOSTON_BIGSCREEN
	bool "bigfoston-bigscreen"
	help
	  Big Screen Monitor Display client (FSP v1 over a serial
	  device, drawing into /dev/fb0, touch from evdev).
```

## firmware/buildroot/package/bigfoston-bringup/Config.in
```kconfig
config BR2_PACKAGE_BIGFOSTON_BRINGUP
	bool "bigfoston-bringup"
	help
	  Hardware bring-up tests for the FS-707DC (bftest): processes,
	  signals, copy-on-write, unaligned access, memcpy, BusyBox page
	  integrity. Run as rdinit=/bin/bftest.
```

## firmware/buildroot/package/bigfoston-bt/Config.in
```kconfig
config BR2_PACKAGE_BIGFOSTON_BT
	bool "bigfoston-bt"
	help
	  Bluetooth of the FOSTON FS-707DC (MediaTek MT6611 on UART2):
	  bfbt-attach powers the chip like the Windows CE driver and hands the
	  UART to the kernel HCI layer (H4); btprobe sends raw HCI commands for
	  tests (docs/hardware-enablement/06-bluetooth-hardware.md).
```

## firmware/buildroot/package/bigfoston-espeak-ng/Config.in
```kconfig
config BR2_PACKAGE_BIGFOSTON_ESPEAK_NG
	bool "bigfoston-espeak-ng"
	depends on BR2_USE_WCHAR
	help
	  eSpeak NG speech synthesizer (command line program only) for
	  the Big GPS spoken directions in Brazilian Portuguese.  The
	  voice data is not installed: it goes on the SD card
	  (BigFoston/big-gps/voz/espeak-ng-data, docs/big-gps/09-voz.md).

	  https://github.com/espeak-ng/espeak-ng
```

## firmware/buildroot/package/bigfoston-fm/Config.in
```kconfig
config BR2_PACKAGE_BIGFOSTON_FM
	bool "bigfoston-fm"
	help
	  FM transmitter of the FOSTON FS-707DC (KT Micro KT0801A on the
	  MT3351 I2C, 32 kHz reference from PWM3): bffm turns it on and off,
	  sets the frequency and the audio output (docs/fm-radio).
```

## firmware/buildroot/package/bigfoston-gps/Config.in
```kconfig
config BR2_PACKAGE_BIGFOSTON_GPS
	bool "bigfoston-gps"
	help
	  GPS of the FOSTON FS-707DC: bfgps runs the device's own Windows CE
	  gps.dll (MediaTek MT3328 MNL) in a Linux process and publishes NMEA
	  and a status file (docs/gps.md). The DLL image is extracted from the
	  device's NAND by tools/bigfoston/gps-extract.py and kept on its SD
	  card; it is not part of BigFoston.
```

## firmware/buildroot/package/bigfoston-shell/Config.in
```kconfig
config BR2_PACKAGE_BIGFOSTON_SHELL
	bool "bigfoston-shell"
	help
	  BigFoston OS graphical shell (LVGL 9.2, /dev/fb0 + evdev touch),
	  started at boot by /etc/init.d/S90bigfoston-shell unless the
	  kernel command line contains "nogui".
```

## firmware/kernel/overlay/arch/arm/mach-mt3351/Kconfig
```kconfig
# SPDX-License-Identifier: GPL-2.0-only
menuconfig ARCH_MT3351
	bool "MediaTek MT3351 (FOSTON FS-707DC and similar GPS navigators)"
	depends on ARCH_MULTI_V6
	depends on CPU_LITTLE_ENDIAN
	select MT3351_CIRQ
	select MT3351_GPT_TIMER
	select ARM_ERRATA_411920
	help
	  MediaTek MT3351 SoC (ARM1176JZ-S) found in Windows CE GPS
	  navigators such as the FOSTON FS-707DC. Started from Windows CE by
	  the BigFoston loader; RAM at 0, CIRQ interrupt controller and GPT
	  timer as measured on the device.

if ARCH_MT3351

config MT3351_BOOTCON
	bool "Text console on the boot loader framebuffer"
	default y
	select FONT_SUPPORT
	select FONT_8x8
	help
	  Draws kernel messages into the framebuffer left running by Windows
	  CE (simple-framebuffer node), starting before the timer is set up.
	  The board has no known serial console.

endif
```
